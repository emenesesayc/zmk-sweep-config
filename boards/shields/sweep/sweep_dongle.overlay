
#include "sweep.dtsi"

/ {
    chosen {
        zmk,kscan = &mock_kscan;
	zmk,physical-layout = &cuddlykeyboards_ferris_layout;
    };

    mock_kscan: kscan_1 {
        compatible = "zmk,kscan-mock";
        columns = <0>;
        rows = <0>;
        events = <0>;
    };

};
